## kernel/Kconfig
```kconfig
# SPDX-License-Identifier: GPL-2.0
#
# For a description of the syntax of this configuration file,
# see Documentation/kbuild/kconfig-language.rst.
#
mainmenu "Linux/$(ARCH) $(KERNELVERSION) Kernel Configuration"

################################################################################
# Added by Ngoc Hien Tran
################################################################################
# REASON:
#	To address the issue that the module tpd.ko MUST be created during
#		the ISPBOOOT.BIN build-process.
# MANDATORY: 
#	INCLUDE the 'tpd' folder, which is part of directory (/root/SP7021/linux/kernel/drivers).
# NOTE: 
#	Fullpath is of the 'tpd' folder is (/root/SP7021/linux/kernel/drivers/tpd).
################################################################################
source "drivers/tpd/Kconfig"

source "scripts/Kconfig.include"

source "init/Kconfig"

source "kernel/Kconfig.freezer"

source "fs/Kconfig.binfmt"

source "mm/Kconfig"

source "net/Kconfig"

source "drivers/Kconfig"

source "fs/Kconfig"

source "security/Kconfig"

source "crypto/Kconfig"

source "lib/Kconfig"

source "lib/Kconfig.debug"

source "Documentation/Kconfig"
```

## kernel/Kconfig.patch
```kconfig
--- Kconfig.old	2023-11-14 09:09:46.000000000 +0000
+++ Kconfig.new	2024-04-15 02:17:19.000000000 +0000
@@ -5,6 +5,8 @@
 #
 mainmenu "Linux/$(ARCH) $(KERNELVERSION) Kernel Configuration"
 
+source "drivers/tpd/Kconfig"
+
 source "scripts/Kconfig.include"
 
 source "init/Kconfig"
```

## kernel/drivers/tpd/Kconfig
```kconfig
##################################################################################
# Kconfig created by Ngoc Hien Tran
# NOTE 1: 
#   /root/SP7021/linux/kernel/Kconfig also needs to be modified by adding
#       the following line:
#           source "drivers/tpd/Kconfig"
# NOTE 2:
#   If a Kconfig is created from scratch, and when running 'make kconfig', then
#       error may occur saying 'warning: ignoring unsupported character'. To avoid
#       this error:
#       1. copy/paste a good working Kconfig from another object to the drivers/tpd folder.
#       2. Remove the content of this copied Kconfig.
#       3. Paste the tpd's Kconfig commands into this copied Kconfig file.
##################################################################################
# SPDX-License-Identifier: GPL-2.0-only
menu "TPD Settings (NHT)"
config TPD
    tristate "Enable TPD driver"
    default m
    help
        Enable support for the TPD driver.
endmenu
```
